## config/west.yml
```yaml
manifest:
  remotes:
    - name: petejohanson
      url-base: https://github.com/petejohanson
    - name: badjeff
      url-base: https://github.com/badjeff  
  projects:
    - name: zmk
      remote: petejohanson
      revision: feat/pointers-move-scroll
      import: app/west.yml
    - name: zmk-pmw3610-driver
      remote: badjeff
      revision: main
    - name: zmk-split-peripheral-input-relay
      remote: badjeff
      revision: main
    - name: zmk-input-behavior-listener
      remote: badjeff
      revision: main
  self:
    path: config
```
