#include "charybdis.dtsi"

&default_transform {
	col-offset = <6>;
};

&five_column_transform {
	col-offset = <5>;
};

&kscan0 {
	col-gpios
		= <&pro_micro 7 GPIO_ACTIVE_HIGH>
		, <&pro_micro 6 GPIO_ACTIVE_HIGH>
		, <&pro_micro 10 GPIO_ACTIVE_HIGH>
		, <&pro_micro 20 GPIO_ACTIVE_HIGH> 
		, <&pro_micro 19 GPIO_ACTIVE_HIGH>
		;
};

// trackball
#include "pwm3610dm_trackball.dtsi"

&spi1 {
    status = "okay";
};    

&trackball {
	status = "okay";    
};

/ {
	trackball: virtual_input_0 {
		compatible = "zmk,virtual-input";

	pd1: virtual_input_1 {
		compatible = "zmk,virtual-input";
	};

	input_relay_config_102 {
		compatible = "zmk,split-peripheral-input-relay";
		device = <&trackball>;
		relay-channel = <102>;
	};
};
